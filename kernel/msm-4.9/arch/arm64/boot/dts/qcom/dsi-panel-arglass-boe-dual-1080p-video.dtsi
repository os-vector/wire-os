/* Copyright (c) 2020-2021, The Linux Foundation. All rights reserved.
 *
 * This program is free software; you can redistribute it and/or modify
 * it under the terms of the GNU General Public License version 2 and
 * only version 2 as published by the Free Software Foundation.
 *
 * This program is distributed in the hope that it will be useful,
 * but WITHOUT ANY WARRANTY; without even the implied warranty of
 * MERCHANTABILITY or FITNESS FOR A PARTICULAR PURPOSE.  See the
 * GNU General Public License for more details.
 */

&mdss_mdp {
	dsi_dual_arglass_boe_dual_1080p_video: qcom,mdss_dsi_arglass_cmd_boe {
		qcom,mdss-dsi-panel-name =
			"Dual ARGlass video mode dsi BOE panel without DSC";
		qcom,mdss-dsi-panel-type = "dsi_video_mode";
		qcom,mdss-dsi-virtual-channel-id = <0>;
		qcom,mdss-dsi-stream = <0>;
		qcom,mdss-dsi-panel-hdr-enabled;
		qcom,mdss-dsi-panel-hdr-color-primaries = <14500 15500 32000
				17000 15500 30000 8000 3000>;
		qcom,mdss-dsi-panel-peak-brightness = <4200000>;
		qcom,mdss-dsi-panel-blackness-level = <3230>;
		qcom,mdss-dsi-traffic-mode = "non_burst_sync_event";
		qcom,mdss-dsi-bllp-eof-power-mode;
		qcom,mdss-dsi-bllp-power-mode;
		qcom,mdss-dsi-lane-0-state;
		qcom,mdss-dsi-lane-1-state;
		qcom,mdss-dsi-lane-2-state;
		qcom,mdss-dsi-lane-3-state;
		qcom,mdss-dsi-dma-trigger = "trigger_sw";
		qcom,mdss-dsi-mdp-trigger = "none";
		qcom,mdss-dsi-reset-sequence = <1 20>, <0 20>, <1 50>;
		qcom,mdss-pan-physical-width-dimension = <74>;
		qcom,mdss-pan-physical-height-dimension = <131>;
		qcom,mdss-dsi-tx-eot-append;
		qcom,mdss-dsi-color-order = "rgb_swap_rgb";
		qcom,mdss-dsi-underflow-color = <0xff>;
		qcom,mdss-dsi-border-color = <0>;
		qcom,mdss-dsi-bpp = <24>;
		qcom,mdss-dsi-display-timings {
			timing@0{
				qcom,mdss-dsi-panel-width = <1920>;
				qcom,mdss-dsi-panel-height = <1080>;
				qcom,mdss-dsi-h-front-porch = <56>;
				qcom,mdss-dsi-h-back-porch = <72>;
				qcom,mdss-dsi-h-pulse-width = <32>;
				qcom,mdss-dsi-h-sync-skew = <0>;
				qcom,mdss-dsi-v-back-porch = <8>;
				qcom,mdss-dsi-v-front-porch = <8>;
				qcom,mdss-dsi-v-pulse-width = <4>;
				qcom,mdss-dsi-panel-framerate = <60>;
				qcom,mdss-dsi-on-command = [
					39 01 00 00 00 00 02 03 00
					39 01 00 00 00 00 02 53 20
					/* Brightness control, max: 0xff */
					39 01 00 00 00 00 03 51 7F 00
					39 01 00 00 00 00 02 6B 00
					39 01 00 00 00 00 05 80 01 E0 0E 11
					39 01 00 00 00 00 08 81 02 20 00 0C 00
						08 01
					39 01 00 00 00 00 08 82 02 20 00 08 00
						10 01
					/* Flip by 180 */
					39 01 00 00 00 00 02 36 03
					39 01 00 04 00 00 02 36 00
					39 01 00 00 00 00 02 35 00
					/* CMD2 P1 */
					39 01 00 00 00 00 03 F0 AA 11
					39 01 00 00 00 00 0A C2 00 00 03 FF 03
						 FF 00 90 C2
					/* CMD2 P2 */
					39 01 00 00 00 00 03 F0 AA 12
					39 01 00 00 00 00 02 B0 93
					39 01 00 00 00 00 03 B6 14 14
					39 01 00 00 00 00 03 B9 01 73
					39 01 00 00 00 00 05 BA 01 20 01 83
					39 01 00 00 00 00 03 FF 5A 81
					39 01 00 00 00 00 02 65 14
					39 01 00 00 00 00 12 F9 64 68 6C 70 74
					 78 7C 80 84 88 8C 90 95 9A A0 A5 B0
					39 01 00 00 00 00 02 26 20
					39 01 00 00 00 00 03 F0 AA 13
					39 01 00 00 00 00 02 D5 00
					05 01 00 00 cb 00 02 11 00
					05 01 00 00 00 00 02 29 00
					];

				qcom,mdss-dsi-off-command = [05 01 00 00 0a 00
					02 28 00 05 01 00 00 3c 00 02 10 00];

				qcom,mdss-dsi-on-command-state = "dsi_lp_mode";
				qcom,mdss-dsi-off-command-state = "dsi_hs_mode";

			};
		};
	};
};
