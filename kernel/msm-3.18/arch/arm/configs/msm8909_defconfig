## poky/victor/meta-qcom/conf/distro/auto-eap-nand.conf
```bitbake
#############################################################################
#@TYPE: Distribution
#@NAME: AUTO-EAP-NAND
#@DESCRIPTION: For NAND based EAP targets for Automotive
#############################################################################
require conf/distro/include/base.inc

# DISTRO CONFIGURATION
DISTRO_NAME = "auto-eap-nand"
DISTRO_VERSION = "${BUILDNAME}"

# Basic distribution features
DISTRO_FEATURES += "eabi ipv6 ipv4 largefile thumb-interwork xattr"

# Distro features
DISTRO_FEATURES += "nand-boot"
DISTRO_FEATURES_NATIVE += "nand-boot"
DISTRO_FEATURES += "nand-squashfs"
DISTRO_FEATURES += "no-ssd-listener-support"
DISTRO_FEATURES += "no-rpmb-listener-support"
DISTRO_FEATURES += "persist-volume"
DISTRO_FEATURES:remove = "persist-image"

# Comment below NAND_AB_SUPPORT flag to disable nand ab-boot-support
NAND_AB_SUPPORT="true"
DISTRO_FEATURES        += "${@bb.utils.contains('NAND_AB_SUPPORT', 'true', 'ab-boot-support nand-ab', '', d)}"
DISTRO_FEATURES_NATIVE += "${@bb.utils.contains('NAND_AB_SUPPORT', 'true', 'ab-boot-support', '', d)}"

# Enable SELinux
DISTRO_FEATURES += "selinux"
DISTRO_FEATURES_FILTER_NATIVE  += "selinux"
DEFAULT_ENFORCING = "enforcing"

# Enable early ethernet
DISTRO_FEATURES += "early-eth"

# Enable performance features
PERF_BUILD = "${@['0', '1'][d.getVar('VARIANT', True) != ('' or 'debug')]}"
```

## poky/victor/meta-qcom/conf/distro/auto.conf
```bitbake
BASEDISTRO ?= "mdm"

require conf/distro/mdm.conf

DISTRO_NAME = "auto"
DISTROOVERRIDES =. "${BASEMACHINE}-auto:"

PRODUCT = "auto"

# Enable early ethernet
DISTRO_FEATURES += "early-eth"

# Enable SELinux
DISTRO_FEATURES += "selinux"
DISTRO_FEATURES_FILTER_NATIVE  += "selinux"
DEFAULT_ENFORCING = "enforcing"

# Enable openavb
DISTRO_FEATURES += "openavb"

# Enable FS HMS
DISTRO_FEATURES += "fs_hms_support"

# Enable TelSdk
DISTRO_FEATURES += "qti-telux"

# Use systemd init manager.
DISTRO_FEATURES:remove = "sysvinit"
DISTRO_FEATURES:append = " systemd"
DISTRO_FEATURES_OPTED_OUT += "sysvinit"

INCOMPATIBLE_LICENSE += "GPL-3.0 LGPL-3.0 AGPL-3.0"
WHITELIST_GPL-3.0 += "bash coreutils gawk gdb gdbm gettext m4 readline findutils grep elfutils"
PACKAGE_EXCLUDE += "bash gawk gdbm gettext m4 readline elfutils"
```

## poky/victor/meta-qcom/conf/distro/mdm.conf
```bitbake
#############################################################################
#@TYPE: Distribution
#@NAME: MDM
#@DESCRIPTION: QTI Linux Distribution for MDM targets (glibc based)
#############################################################################
require conf/distro/include/base.inc
require conf/distro/include/yocto-uninative.inc

# DISTRO CONFIGURATION
DISTRO_NAME = "mdm"
DISTRO_VERSION = "${BUILDNAME}"
VIRTUAL-RUNTIME_dev_manager ?= "busybox-mdev"

# Add distro overrides
DISTROOVERRIDES =. "mdm:"

# Basic distribution features
DISTRO_FEATURES += "sysvinit eabi ipv6 ipv4 largefile thumb-interwork xattr ld-is-gold"

# MDMs are nand based targets
DISTRO_FEATURES += "nand-boot"

#Enable for Read only system
DISTRO_FEATURES += "ro-rootfs"

# Enable performance features
PERF_BUILD = "${@['0', '1'][d.getVar('VARIANT', True) != ('' or 'debug')]}"

INCOMPATIBLE_LICENSE += "GPL-3.0 LGPL-3.0 AGPL-3.0"
WHITELIST_GPL-3.0 += "coreutils gettext bash grep m4 findutils elfutils gdbm readline"
PACKAGE_EXCLUDE += "gdb gdbserver gdbm gettext m4 elfutils readline"
```

## poky/victor/meta-qcom/conf/distro/msm.conf
```bitbake
#############################################################################
#@TYPE: Distribution
#@NAME: MSM
#@DESCRIPTION: MSM Linux Distribution (glibc based)
#############################################################################
require conf/distro/include/base.inc

# DISTRO CONFIGURATION
DISTRO_NAME ?= "msm"
DISTRO_VERSION ?= "${BUILDNAME}"
#VIRTUAL-RUNTIME_dev_manager ?= "busybox-mdev"

# Add distro overrides
DISTROOVERRIDES =. "msm:"

# Basic distribution features
DISTRO_FEATURES += "sysvinit eabi ipv6 ipv4 largefile thumb-interwork xattr ${DISTRO_FEATURES_LIBC}"

# MSMs are emmc based targets
DISTRO_FEATURES += "emmc-boot"

# drm driver
DISTRO_FEATURES += "drm"

DISTRO_FEATURES += " virtualization seccomp"

# Enable performance features
PERF_BUILD = "${@['0', '1'][d.getVar('VARIANT', True) != ('' or 'debug')]}"

# Build optimization to disable debugging features, mainly for production images.
USER_BUILD = "${@['0', '1'][d.getVar('VARIANT', True) == 'user']}"
```

## poky/victor/meta-qcom/conf/machine/apq8009.conf
```bitbake
#@TYPE: Machine
#@NAME: APQ8009 MTP
#@DESCRIPTION: Machine configuration for QTI MTP with APQ8009

require conf/machine/include/apq8009.inc

PREFERRED_PROVIDER_virtual/bootloader = "lk"

KERNEL_IMAGETYPE = "zImage-dtb"
KERNEL_DTS_NAME = "msm8909"
KERNEL_BASE = "0x81C00000"
KERNEL_TAGS_OFFSET = "0x81900000"

KERNEL_CONFIG = "${@['msm8909-perf_defconfig', 'msm8909_defconfig'][d.getVar('VARIANT', True) == ('' or 'debug')]}"

KERNEL_CMD_PARAMS = "console=ttyMSM0,115200n8 loglevel=4 ro androidboot.hardware=qcom androidboot.bootdevice=7824900.sdhci ehci-hcd.park=3 msm_rtb.filter=0x37 lpm_levels.sleep_disabled=1 mem=511M firmware_class.path=/lib/firmware/image watchdog_v2.enable=0 kgsl.mmutype=nommu cma=64M"
KERNEL_CMD_PARAMS:remove = "${@bb.utils.contains_any('VARIANT', 'perf user', 'console=ttyHSL0,115200,n8', '', d)}"

# readonly-rootfs
DISTRO_FEATURES += " ro-rootfs"

#enable selinux
DISTRO_FEATURES += " selinux"
DEFAULT_ENFORCING = "enforcing"

# Use systemd init manager.
DISTRO_FEATURES:remove = "sysvinit"
DISTRO_FEATURES += " systemd"
DISTRO_FEATURES_OPTED_OUT += "sysvinit"
VIRTUAL-RUNTIME_dev_manager = "udev"
VIRTUAL-RUNTIME_init_manager = "systemd"

# Change Image features for systemd.
IMAGE_DEV_MANAGER = "udev"
IMAGE_INIT_MANAGER = "systemd"
IMAGE_INITSCRIPTS = ""

PREFERRED_VERSION_gstreamer1.0="1.12.2"
PREFERRED_VERSION_gstreamer1.0-plugins-base="1.12.2"
PREFERRED_VERSION_gstreamer1.0-plugins-good="1.12.2"
PREFERRED_VERSION_gstreamer1.0-plugins-bad="1.12.2"
PREFERRED_VERSION_gstreamer1.0-libav="1.12.2"
PREFERRED_VERSION_gstreamer1.0-omx="1.12.2"
PREFERRED_VERSION_gstreamer1.0-rtsp-server="1.12.2"
```

## poky/victor/meta-qcom/conf/machine/apq8017.conf
```bitbake
#@TYPE: Machine
#@NAME: APQ8017
#@DESCRIPTION: Machine configuration for QTI MTP with APQ8017

require conf/machine/include/apq8017.inc

PREFERRED_PROVIDER_virtual/bootloader = "lk"

KERNEL_IMAGETYPE = "Image.gz-dtb"
KERNEL_DTS_NAME = "msm8917"
KERNEL_BASE = "0x81C00000"
KERNEL_TAGS_OFFSET = "0x81900000"

KERNEL_CONFIG = "${@['msm8937-perf_defconfig', 'msm8937_defconfig'][d.getVar('VARIANT', True) == ('' or 'debug')]}"

KERNEL_CMD_PARAMS = "noinitrd ro console=ttyHSL0,115200,n8 androidboot.hardware=qcom ehci-hcd.park=3 msm_rtb.filter=0x37 lpm_levels.sleep_disabled=1 rootwait androidboot.bootdevice=7824900.sdhci"
KERNEL_CMD_PARAMS:remove = "${@bb.utils.contains_any('VARIANT', 'perf user', 'console=ttyHSL0,115200,n8', '', d)}"

# readonly-rootfs
DISTRO_FEATURES:append = " ro-rootfs"

DISTRO_FEATURES:append = " userfs-factory-reset "

#enable selinux
DISTRO_FEATURES:append = " selinux"
DEFAULT_ENFORCING = "enforcing"

# Use systemd init manager.
DISTRO_FEATURES:remove = "sysvinit"
DISTRO_FEATURES:append = " systemd"
DISTRO_FEATURES_OPTED_OUT += "sysvinit"
VIRTUAL-RUNTIME_dev_manager = "udev"
VIRTUAL-RUNTIME_init_manager = "systemd"

# Change Image features for systemd.
IMAGE_DEV_MANAGER = "udev"
IMAGE_INIT_MANAGER = "systemd"
IMAGE_INITSCRIPTS = ""
```

## poky/victor/meta-qcom/conf/machine/apq8053-32.conf
```bitbake
#@TYPE: Machine
#@NAME: APQ8053-32
#@DESCRIPTION: 32-bit Machine configuration for QTI MTP with APQ8053

require conf/machine/include/apq8053.inc

DEFAULTTUNE = "armv7a-neon"

PREFERRED_PROVIDER_virtual/bootloader = "lk"

KERNEL_IMAGETYPE = "zImage-dtb"
KERNEL_DTS_NAME = "msm8953"
KERNEL_BASE = "0x80000000"
KERNEL_TAGS_OFFSET = "0x81900000"

KERNEL_CONFIG = "${@['msm8953-perf_defconfig', 'msm8953_defconfig'][d.getVar('VARIANT', True) == ('' or 'debug')]}"

KERNEL_CMD_PARAMS = "noinitrd ro console=ttyMSM0,115200,n8 androidboot.hardware=qcom ehci-hcd.park=3 msm_rtb.filter=0x37 lpm_levels.sleep_disabled=1 rootwait androidboot.bootdevice=7824900.sdhci"
KERNEL_CMD_PARAMS:remove = "${@bb.utils.contains_any('VARIANT', 'perf user', 'console=ttyMSM0,115200,n8', '', d)}"

# readonly-rootfs
DISTRO_FEATURES:append = " ro-rootfs"

# enable audio as a loadable kernel module
DISTRO_FEATURES:append = " audio-dlkm"

#enable selinux
DISTRO_FEATURES:append = " selinux"
DEFAULT_ENFORCING = "enforcing"

# Use systemd init manager.
DISTRO_FEATURES:remove = "sysvinit"
DISTRO_FEATURES:append = " systemd"
DISTRO_FEATURES_OPTED_OUT += "sysvinit"
VIRTUAL-RUNTIME_dev_manager = "udev"
VIRTUAL-RUNTIME_init_manager = "systemd"

# Change Image features for systemd.
IMAGE_DEV_MANAGER = "udev"
IMAGE_INIT_MANAGER = "systemd"
IMAGE_INITSCRIPTS = ""

# Disable journalling for RO rootfs.
IMAGE_EXT4_EXTRA_OPTIONS = "${@bb.utils.contains('DISTRO_FEATURES','ro-rootfs',' -J -b 4096 ','',d)}"
```

## poky/victor/meta-qcom/conf/machine/apq8053-64.conf
```bitbake
#@TYPE: Machine
#@NAME: APQ8053-64
#@DESCRIPTION: Machine configuration for QTI MTP with APQ8053-64

require conf/machine/include/apq8053.inc

PREFERRED_PROVIDER_virtual/bootloader = "lk"

KERNEL_IMAGETYPE = "${@['Image-dtb', 'Image.gz-dtb'][d.getVar('VARIANT', True) == ('' or 'debug')]}"
KERNEL_DTS_NAME = "msm8953"
KERNEL_BASE = "0x80000000"
KERNEL_TAGS_OFFSET = "0x81900000"

KERNEL_CONFIG = "${@['msm8953-perf_defconfig', 'msm8953_defconfig'][d.getVar('VARIANT', True) == ('' or 'debug')]}"

KERNEL_CMD_PARAMS = "noinitrd ro console=ttyMSM0,115200,n8 androidboot.hardware=qcom ehci-hcd.park=3 msm_rtb.filter=0x37 lpm_levels.sleep_disabled=1 rootwait androidboot.bootdevice=7824900.sdhci"
KERNEL_CMD_PARAMS:remove = "${@bb.utils.contains_any('VARIANT', 'perf user', 'console=ttyMSM0,115200,n8', '', d)}"

# readonly-rootfs
DISTRO_FEATURES:append = " ro-rootfs"

#enable selinux
DISTRO_FEATURES:append = " selinux"
DEFAULT_ENFORCING = "permissive"

# Use systemd init manager.
DISTRO_FEATURES:remove = "sysvinit"
DISTRO_FEATURES:append = " systemd"
DISTRO_FEATURES_OPTED_OUT += "sysvinit"
VIRTUAL-RUNTIME_dev_manager = "udev"
VIRTUAL-RUNTIME_init_manager = "systemd"

# Change Image features for systemd.
IMAGE_DEV_MANAGER = "udev"
IMAGE_INIT_MANAGER = "systemd"
IMAGE_INITSCRIPTS = ""

# Disable journalling for RO rootfs.
IMAGE_EXT4_EXTRA_OPTIONS = "${@bb.utils.contains('DISTRO_FEATURES','ro-rootfs',' -J -b 4096 ','',d)}"

# Multilib configuration
# This sets any packages preprended with lib32- to be built with
# the armv7a tuning (32 bit) instead of 64 bit aarch.
require conf/multilib.conf
MULTILIBS = "multilib:lib32"
DEFAULTTUNE_virtclass-multilib-lib32 = "armv7a-neon"
TARGET_VENDOR_virtclass-multilib-lib32="-oe"
```

## poky/victor/meta-qcom/conf/machine/apq8096.conf
```bitbake
#@TYPE: Machine
#@NAME: APQ8096
#@DESCRIPTION: Machine configuration for QTI MTP with APQ8096

require conf/machine/include/apq8096.inc

PREFERRED_PROVIDER_virtual/bootloader = "lk"

KERNEL_IMAGETYPE = "Image.gz-dtb"
KERNEL_DTS_NAME = "msm8996"
KERNEL_BASE = "0x80000000"
KERNEL_TAGS_OFFSET = "0x81900000"

KERNEL_CONFIG = "${@['msm-perf_defconfig', 'msm_defconfig'][d.getVar('VARIANT', True) == ('' or 'debug')]}"

KERNEL_CMD_PARAMS = "noinitrd rw console=ttyHSL0,115200,n8 androidboot.hardware=qcom ehci-hcd.park=3 msm_rtb.filter=0x37 lpm_levels.sleep_disabled=0 rootwait net.ifnames=0"
KERNEL_CMD_PARAMS:remove = "${@bb.utils.contains_any('VARIANT', 'perf user', 'console=ttyHSL0,115200,n8', '', d)}"

DISTRO_FEATURES:append=" pam"

#enable selinux
DISTRO_FEATURES:append = " selinux"
DEFAULT_ENFORCING = "permissive"

# Use systemd init manager.
DISTRO_FEATURES:remove = "sysvinit"
DISTRO_FEATURES:append = " systemd"
DISTRO_FEATURES_OPTED_OUT += "sysvinit"
VIRTUAL-RUNTIME_dev_manager = "udev"
VIRTUAL-RUNTIME_init_manager = "systemd"

# Change Image features for systemd.
IMAGE_DEV_MANAGER = "udev"
IMAGE_INIT_MANAGER = "systemd"
IMAGE_INITSCRIPTS = ""
```

## poky/victor/meta-qcom/conf/machine/include/qcs40x.inc
```bitbake
BASEMACHINE ?= "qcs40x"
require conf/machine/include/basemachine.inc

SOC_FAMILY ?= "qcs405"
include conf/machine/include/soc-family.inc

# Pull in security flags
require ${COREBASE}/meta-qti-bsp/conf/distro/include/security_flags.inc

include conf/machine/include/arm/arch-armv8.inc

#usb composition to be used by qcs40x devices.
USBCOMPOSITION      = "901D"

PREFERRED_PROVIDER_virtual/kernel = "linux-msm"
PREFERRED_VERSION_linux-msm = "4.14"

# Set openssl10 as openssl provider.
PREFERRED_PROVIDER_openssl          = "openssl10"
PREFERRED_VERSION_openssl10         = "1.0.2q"
PREFERRED_PROVIDER_openssl-native   = "openssl10-native"

MACHINE_DISPLAY_WIDTH_PIXELS ?= "480"
MACHINE_DISPLAY_HEIGHT_PIXELS ?= "640"

SERIAL_CONSOLE ?= "${@['', '115200 ttyMSM0'][d.getVar('VARIANT', True) == ('' or 'debug')]}"
LLVM_VERSION = "6.0"
DISTRO ?= "msm"

DISTRO_FEATURES:append = " ro-rootfs"

# Use systemd init manager.
DISTRO_FEATURES:remove = "sysvinit"
DISTRO_FEATURES:append = " systemd"
DISTRO_FEATURES_OPTED_OUT += "sysvinit"
VIRTUAL-RUNTIME_dev_manager = "udev"
VIRTUAL-RUNTIME_init_manager = "systemd"

# Change Image features for systemd.
IMAGE_DEV_MANAGER = "udev"
IMAGE_INIT_MANAGER = "systemd"
IMAGE_INITSCRIPTS = ""

#Enable SDK feature
# SDK_IMAGE ?= "1"

PAGE_SIZE ?= '4096'

MACHINE_FEATURES += "kernel26 keyboard"

# fbdev driver
MACHINE_FEATURES += "fbdev"

#Enable persist image/volume.
DISTRO_FEATURES += "persist-image"
# Enable LE Verified Boot
DISTRO_FEATURES:append = " vble"

KERNEL_DTS_NAME = "qcs405-rumi"
KERNEL_BASE = "0x80000000"
KERNEL_TAGS_OFFSET = "0x1e00000"

KERNEL_CMD_PARAMS ?= "noinitrd ro rootwait console=ttyMSM0,115200,n8 no_console_suspend=1 androidboot.hardware=qcom androidboot.console=ttyMSM0 lpm_levels.sleep_disabled=1 service_locator.enable=1 firmware_class.path=/lib/firmware/updates msm_rtb.filter=0x237"

# Userspace needs below given macro to support libion after kernel 4.12.
TARGET_CFLAGS:append = " -DTARGET_ION_ABI_VERSION=2 "
TARGET_CXXFLAGS:append = " -DTARGET_ION_ABI_VERSION=2 "
DISTRO_FEATURES:append = " audio-only-libav "
```
