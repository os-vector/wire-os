## poky/victor/meta-qcom/conf/machine/include/sdxprairie.inc
```bitbake
BASEMACHINE ?= "sdxprairie"
require conf/machine/include/basemachine.inc

SOC_FAMILY ?= "mdm9x50"
include conf/machine/include/soc-family.inc

# Pull in security flags
require ${COREBASE}/meta-qti-bsp/conf/distro/include/security_flags.inc

include conf/machine/include/tune-cortexa8.inc

PREFERRED_PROVIDER_virtual/kernel = "linux-msm"
PREFERRED_VERSION_linux-msm = "4.14"

MACHINE_DISPLAY_WIDTH_PIXELS ?= "480"
MACHINE_DISPLAY_HEIGHT_PIXELS ?= "640"

SERIAL_CONSOLES ?= '115200;ttyMSM0'

DISTRO ?= "mdm"

DISTRO_FEATURES:append = " persist-volume"

MACHINE_FEATURES += "kernel26 keyboard ipa-offload"

PAGE_SIZE ?= '4096'

# Max supported inodes
EXTRA_IMAGECMD ?= "-N 2048"

#UBINIZE Args
UBINIZE_ARGS ?= "-m 4096 -p 256KiB -s 4096"
#MKUBIFS Args
MKUBIFS_ARGS ?= "-m 4096 -e 253952 -c 2146 -F"
#Volume sizes
SYSTEM_VOLUME_SIZE ?= "110MiB"
CACHE_VOLUME_SIZE ?= "15MiB"
SYSTEMRW_VOLUME_SIZE ?= "6MiB"
PERSIST_VOLUME_SIZE ?= "6MiB"

# Sizes for EXT4 (in bytes)
SYSTEM_SIZE_EXT4 ?= "100000000"
SYSTEMRW_SIZE_EXT4 ?= "8388608"
USERDATA_SIZE_EXT4 ?= "2000000000"
CACHE_SIZE_EXT4 ?= "80000000"
RECOVERYFS_SIZE_EXT4 ?= "100000000"

# Enable LE Verified Boot
DISTRO_FEATURES:append = " vble"

#Disable rpmb listener
DISTRO_FEATURES:append = " no-rpmb-listener-support"

#Disable ssd listener
DISTRO_FEATURES:append = " no-ssd-listener-support"

# Formats of root filesystem images.
IMAGE_FSTYPES += "ubi"

# Userspace needs below given macro to support libion after kernel 4.12.
TARGET_CFLAGS:append = " -DTARGET_ION_ABI_VERSION=2 "
TARGET_CXXFLAGS:append = " -DTARGET_ION_ABI_VERSION=2 "

# readonly-rootfs
DISTRO_FEATURES:append = " ro-rootfs"

# Use systemd init manager.
DISTRO_FEATURES:remove = "sysvinit"
DISTRO_FEATURES:append = " systemd"
DISTRO_FEATURES_OPTED_OUT += "sysvinit"
VIRTUAL-RUNTIME_dev_manager = "udev"
VIRTUAL-RUNTIME_init_manager = "systemd"

# Change Image features for systemd.
IMAGE_DEV_MANAGER = "udev"
IMAGE_INIT_MANAGER = "systemd"
IMAGE_INITSCRIPTS = ""

# Make sure either INITRAMFS_IMAGE_BUNDLE or  EXT_INITRAMFS_IMAGE_BUNDLE
# is enabled and not both are enabled at the same time

#INITRAMFS_IMAGE_BUNDLE = "${@bb.utils.contains('DISTRO_FEATURES', 'initramfs', '1', '', d)}"
EXT_INITRAMFS_IMAGE_BUNDLE = "${@bb.utils.contains('DISTRO_FEATURES', 'initramfs', '1', '', d)}"
INITRAMFS_IMAGE = "${@bb.utils.contains('DISTRO_FEATURES', 'initramfs', 'machine-initramfs', '', d)}"
INITRAMFS_FSTYPES += "${@bb.utils.contains('DISTRO_FEATURES', 'initramfs', 'cpio.gz tar.bz2', '', d)}"
```

## poky/victor/meta-qcom/conf/machine/qcs605-32.conf
```bitbake
#@TYPE: Machine
#@NAME: QCS605-32
#@DESCRIPTION: Machine configuration for QTI QCS605 32bit

require conf/machine/include/qcs605.inc

DEFAULTTUNE = "armv7ahf-neon"

KERNEL_IMAGETYPE = "zImage-dtb"

KERNEL_DTS_NAME = "qcs605"
KERNEL_BASE = "0x80000000"
KERNEL_TAGS_OFFSET = "0x81900000"

KERNEL_CONFIG = "${@['sdm670-perf_defconfig', 'sdm670_defconfig'][d.getVar('VARIANT', True) == ('' or 'debug')]}"

KERNEL_CMD_PARAMS = "console=ttyMSM0,115200n8 earlycon=msm_geni_serial,0xA90000 androidboot.hardware=qcom androidboot.console=ttyMSM0 video=vfb:640x400,bpp=32,memsize=3072000 msm_rtb.filter=0x237 ehci-hcd.park=3 lpm_levels.sleep_disabled=1 service_locator.enable=1 firmware_class.path=/lib/firmware/updates rootfstype=ext4"

# Run fsck at boot
KERNEL_CMD_PARAMS:append = " fsck.mode=force fsck.repair=yes "

# Remove console parameters and supress systemd logs for non-debug builds.
KERNEL_CMD_PARAMS:remove = "${@bb.utils.contains_any('VARIANT', 'perf user', 'console=ttyMSM0,115200n8', '', d)}"
KERNEL_CMD_PARAMS:remove = "${@bb.utils.contains_any('VARIANT', 'perf user', 'earlycon=msm_geni_serial,0xA90000', '', d)}"
KERNEL_CMD_PARAMS:remove = "${@bb.utils.contains_any('VARIANT', 'perf user', 'androidboot.console=ttyMSM0', '', d)}"
KERNEL_CMD_PARAMS:append = "${@bb.utils.contains_any('VARIANT', 'perf user', ' quiet systemd.log_target=null', '', d)}"

# readonly-rootfs
DISTRO_FEATURES:append = " ro-rootfs"

# Generate persist image
DISTRO_FEATURES += "persist-image"

#Enable virtualization support on LE platform
#DISTRO_FEATURES:append = " virtualization"

# Use systemd init manager.
DISTRO_FEATURES:remove = "sysvinit"
DISTRO_FEATURES:append = " systemd"
DISTRO_FEATURES_OPTED_OUT += "sysvinit"
VIRTUAL-RUNTIME_dev_manager = "udev"
VIRTUAL-RUNTIME_init_manager = "systemd"

#enable selinux
DISTRO_FEATURES:append = " selinux"
DEFAULT_ENFORCING = "enforcing"

#Enable dm-verity feature for non debug builds
DISTRO_FEATURES += "${@bb.utils.contains('DEBUG_BUILD', '1', '', 'dm-verity', d)}"

# enable audio as a loadable kernel module
DISTRO_FEATURES:append = " audio-dlkm"

# Change Image features for systemd.
IMAGE_DEV_MANAGER = "udev"
IMAGE_INIT_MANAGER = "systemd"
IMAGE_INITSCRIPTS = ""

# Disable journalling for RO rootfs. Set the block size to 1024.
IMAGE_EXT4_EXTRA_OPTIONS = "${@bb.utils.contains('DISTRO_FEATURES','ro-rootfs',' -J -b 4096 ','',d)}"

# Multilib configuration
# This sets any packages preprended with lib64- to be built with
# the aarch64 tuning (64 bit) instead of 64 bit aarch.
# Need for compiling UEFI for aarch64
require conf/multilib.conf
MULTILIBS = "multilib:lib64"
DEFAULTTUNE_virtclass-multilib-lib64 = "aarch64"
TARGET_VENDOR_virtclass-multilib-lib64="-oe"

QPERM_FILE_pn-start-script-ab-slot-util = "${bindir}/getslotsuffix:0:1000"
QPERM_FILE_pn-system-core = "${sysconfdir}/build.prop:5002:5002"
QPERM_FILE_pn-system-prop = "/build.prop:5002:5002"

# Enable coedump
SYSTEMD_ENABLE_COREDUMP = "1"
SYSTEMD_COREDUMP_PATH = "${userfsdatadir}/coredump"

#Uncomment to Enable SNPE wrapper compilation
#DISTRO_FEATURES += "snpe-enable"

#Enable TFlite wrapper compilation
DISTRO_FEATURES += "tflite-enable"
```

## poky/victor/meta-qcom/conf/machine/sdm845.conf
```bitbake
#@TYPE: Machine
#@NAME: SDM845
#@DESCRIPTION: Machine configuration for QTI SDM845

require conf/machine/include/sdm845.inc

KERNEL_IMAGETYPE = "Image.gz-dtb"

KERNEL_DTS_NAME = "sdm845"
KERNEL_BASE = "0x80000000"
KERNEL_TAGS_OFFSET = "0x81900000"

KERNEL_CONFIG = "${@['sdm845-perf_defconfig', 'sdm845_defconfig'][d.getVar('VARIANT', True) == ('' or 'debug')]}"

KERNEL_CMD_PARAMS = "console=ttyMSM0,115200n8 earlycon=msm_geni_serial,0xA84000 androidboot.hardware=qcom androidboot.console=ttyMSM0 video=vfb:640x400,bpp=32,memsize=3072000 msm_rtb.filter=0x237 ehci-hcd.park=3 lpm_levels.sleep_disabled=1 service_locator.enable=1 firmware_class.path=/lib/firmware/updates rootfstype=ext4"

# Remove console related parameters for non-debug builds.
KERNEL_CMD_PARAMS:remove = "${@bb.utils.contains_any('VARIANT', 'perf user', 'console=ttyMSM0,115200n8', '', d)}"
KERNEL_CMD_PARAMS:remove = "${@bb.utils.contains_any('VARIANT', 'perf user', 'earlycon=msm_geni_serial,0xA84000', '', d)}"
KERNEL_CMD_PARAMS:remove = "${@bb.utils.contains_any('VARIANT', 'perf user', 'androidboot.console=ttyMSM0', '', d)}"
KERNEL_CMD_PARAMS:append = "${@bb.utils.contains_any('VARIANT', 'perf user', ' quiet systemd.log_target=null', '', d)}"

# readonly-rootfs
DISTRO_FEATURES:append = " ro-rootfs"

# Generate persist image
DISTRO_FEATURES += "persist-image"

# Use systemd init manager.
DISTRO_FEATURES:remove = "sysvinit"
DISTRO_FEATURES:append = " systemd"
DISTRO_FEATURES_OPTED_OUT += "sysvinit"
VIRTUAL-RUNTIME_dev_manager = "udev"
VIRTUAL-RUNTIME_init_manager = "systemd"

#enable selinux
DISTRO_FEATURES:append = " selinux"
DEFAULT_ENFORCING = "permissive"

# enable audio as a loadable kernel module
#DISTRO_FEATURES:append = " audio-dlkm"

# Change Image features for systemd.
IMAGE_DEV_MANAGER = "udev"
IMAGE_INIT_MANAGER = "systemd"
IMAGE_INITSCRIPTS = ""

# Disable journalling for RO rootfs. Set the block size to 4096.
IMAGE_EXT4_EXTRA_OPTIONS = "${@bb.utils.contains('DISTRO_FEATURES','ro-rootfs',' -J -b 4096 ','',d)}"

# Multilib configuration
# This sets any packages preprended with lib32- to be built with
# the armv7a tuning (32 bit) instead of 64 bit aarch.
require conf/multilib.conf
MULTILIBS = "multilib:lib32"
DEFAULTTUNE_virtclass-multilib-lib32 = "armv7ahf-neon"
TARGET_VENDOR_virtclass-multilib-lib32="-oe"

QPERM_FILE_pn-start-script-ab-slot-util = "${bindir}/getslotsuffix:0:1000"
QPERM_FILE_pn-system-core = "${sysconfdir}/build.prop:5002:5002"
QPERM_FILE_pn-system-prop = "/build.prop:5002:5002"

#Enable virtualization support on LE platform
# DISTRO_FEATURES:append = " virtualization"

# Enable ROS
DISTRO_FEATURES:append = " ros"
```
