## poky/victor/meta-anki/conf/layer.conf
```bitbake
BBFILES += "${LAYERDIR}/recipes*/*/*.bb ${LAYERDIR}/recipes*/*/*.bbappend"
BBPATH .= ":${LAYERDIR}"
BBFILE_COLLECTIONS += "wireos"
BBFILE_PRIORITY_wireos =  "12"
BBFILE_PATTERN_wireos := "^${LAYERDIR}/"
LAYERSERIES_COMPAT_wireos = "whinlatter"
```

## poky/victor/meta-qcom-prop/conf/layer.conf
```bitbake
# We have a conf and classes directory, add to BBPATH
BBPATH .= ":${LAYERDIR}"

# We have recipes-* directories, add to BBFILES
BBFILES += "${LAYERDIR}/recipes-*/*/*.bb \
            ${LAYERDIR}/recipes-*/*/*.bbappend"

BBFILE_COLLECTIONS += "meta-qcom-prop"
LAYERSERIES_COMPAT_meta-qcom-prop = "whinlatter"
BBFILE_PATTERN_meta-qcom-prop = "^${LAYERDIR}/"
BBFILE_PRIORITY_meta-qcom-prop = "6"
```

## poky/victor/meta-qcom/conf/layer.conf
```bitbake
BBPATH .= ":${LAYERDIR}"

BBFILE_COLLECTIONS += "msm"
BBFILE_PRIORITY_msm = "10"
BBFILE_PATTERN_msm := "^${LAYERDIR}/"
LAYERSERIES_COMPAT_msm = "whinlatter"
LICENSE_PATH += "${LAYERDIR}/files/common-licenses"
LICENSE_PATH += "${LAYERDIR}/files/anki-licenses"

# Tools needed on the build host for usage within build tasks by recipes of this layer.
HOSTTOOLS_NONFATAL += "xgettext msgmerge msgfmt gmsgfmt java zip"

BBFILES += " ${LAYERDIR}/recipes*/*/*.bb \
             ${LAYERDIR}/recipes*/*/*.bbappend"

# Parse below bbappends only when virtualization layer is present
#BBFILES:DYNAMIC += " \
#    virtualization-layer:${LAYERDIR}/dynamic-recipes/recipes-containers/docker/docker_git.bbappend \
#    virtualization-layer:${LAYERDIR}/dynamic-recipes/recipes-devtools/python/python3-dockerpty_%.bbappend \
#"
```

## poky/victor/meta-qcom/conf/machine/include/apq8009.inc
```bitbake
BASEMACHINE ?= "apq8009"
require conf/machine/include/basemachine.inc

SOC_FAMILY ?= "msm8909"
include conf/machine/include/soc-family.inc

# Pull in security flags
#require ${COREBASE}/../victor/meta-qcom/conf/distro/include/security_flags.inc

DEFAULTTUNE ?= "armv7a-neon-vfpv4"

include conf/machine/include/arm/armv7a/tune-cortexa7.inc

PREFERRED_PROVIDER_virtual/kernel = "linux-msm"
PREFERRED_VERSION_linux-msm = "3.18"

MACHINE_DISPLAY_WIDTH_PIXELS ?= "480"
MACHINE_DISPLAY_HEIGHT_PIXELS ?= "640"

SERIAL_CONSOLE ?= "${@['', '115200 ttyHSL0'][d.getVar('VARIANT', True) == ('' or 'debug')]}"

DISTRO ?= "msm"

DISTRO_FEATURES += "persist-image"

MACHINE_FEATURES += "kernel26 keyboard"

PAGE_SIZE ?= '4096'

# Max supported inodes
EXTRA_IMAGECMD ?= "-N 2048"

MACHINE_MNT_POINTS = "/firmware /persist /cache"

# Sizes for EXT4 (in bytes)
SYSTEM_SIZE_EXT4 ?= "973078528"
SYSTEMRW_SIZE_EXT4 ?= "8388608"
USERDATA_SIZE_EXT4 ?= "524288000"
CACHE_SIZE_EXT4 ?= "524288000"
RECOVERYFS_SIZE_EXT4 ?= "136000000"

#Enable Recovery image generation
RECOVERY_IMAGE ?= "1"

# Formats of root filesystem images.
IMAGE_FSTYPES += "ext4"

#Enable SDK feature
# SDK_IMAGE ?= "1"
```

## poky/victor/meta-qcom/conf/machine/sa515m.conf
```bitbake
#@TYPE: Machine
#@NAME: SA515M
#@DESCRIPTION: Machine configuration for QTI sa515m

require conf/machine/include/sdxprairie.inc

KERNEL_IMAGETYPE = "zImage-dtb"
KERNEL_DTS_NAME = "sdxprairie"
KERNEL_BASE = "0x80000000"
KERNEL_TAGS_OFFSET = "0x82000000"
KERNEL_LOAD_ADDR = "0x85400000"

KERNEL_CONFIG = "${@['sa515m-perf_defconfig', 'sa515m_defconfig'][d.getVar('VARIANT', True) == ('' or 'debug')]}"

KERNEL_CMD_PARAMS = "ro rootwait console=ttyMSM0,115200,n8 androidboot.hardware=qcom msm_rtb.filter=0x237 androidboot.console=ttyMSM0 lpm_levels.sleep_disabled=1 firmware_class.path=/lib/firmware/updates service_locator.enable=1 net.ifnames=0"
KERNEL_CMD_PARAMS += "${@bb.utils.contains('DISTRO_FEATURES', 'nad-avb', 'nad_avb=1', '', d)}"
KERNEL_CMD_PARAMS += "${@bb.utils.contains('DISTRO_FEATURES', 'nad-fde', 'nad_fde=1 fde.system.0', '', d)}"
KERNEL_CMD_PARAMS:remove = "${@bb.utils.contains_any('VARIANT', 'perf user', 'console=ttyMSM0,115200,n8 androidboot.console=ttyMSM0', '', d)}"

BOOTIMAGE_TARGET = "${MACHINE}-boot.img"

LLVM_VERSION = "6.0"


# Volume sizes
SYSTEM_VOLUME_SIZE = "125MiB"
CACHE_VOLUME_SIZE = "15MiB"
SYSTEMRW_VOLUME_SIZE = "6MiB"
PERSIST_VOLUME_SIZE = "6MiB"

# Enable audio kernel
DISTRO_FEATURES += "audiodlkm audio-dlkm"

# Uncomment below lines to Enable flashless feature
# Add squashfs-xz filesystem needed
#DISTRO_FEATURES += "flashless"
#IMAGE_FSTYPES += "squashfs-xz"

RAMDISK = "${IMGDEPLOYDIR}/machine-image-${MACHINE}-flashless.squashfs-xz"
RAMDISK_OFFSET = "0x02200000"

MACHINE_MNT_POINTS = "/firmware /persist /cache"

# Enable coredump
SYSTEMD_ENABLE_COREDUMP = "1"
SYSTEMD_COREDUMP_PATH = "${userfsdatadir}/coredump"

# Enable rootfs_flashless
IMAGE_ROOTFS_FLASHLESS = "${UNPACKDIR}/rootfs_flashless"
USERDATAIMAGE_TARGET   = "${MACHINE}-usrfs.ext4"
SYSTEMRWIMAGE_TARGET   = "${MACHINE}-systemrw.ext4"
PERSISTIMAGE_TARGET    = "${MACHINE}-persist.ext4"

# Create different label for this machine
MAKEEXT4_USRDATA_LABEL_OPT = "-L mdm_userdata"
SYSTEMRW_LABEL             = "mdm_systemrw"
PERSIST_LABEL              = "mdm_persist"

# Size of ext4 (in bytes)
USERDATA_SIZE_EXT4 = "73400320"
SYSTEMRW_SIZE_EXT4 = "8808038"
PERSIST_SIZE_EXT4  = "4404019"

# Enable early USB init
DISTRO_FEATURES:append = " early-usb-init"

# Enable support for KM Multi userspace 
#DISTRO_FEATURES:append = " enable-kmlite-multi"

# Enable SDK feature
SDK_IMAGE = "1"

PREFERRED_VERSION_tcpdump = "4.9.2"
```

## poky/victor/meta-vicos-mods/conf/layer.conf
```bitbake
# We have a conf and classes directory, add to BBPATH
BBPATH .= ":${LAYERDIR}"

# We have recipes-* directories, add to BBFILES
BBFILES += "${LAYERDIR}/recipes-*/*/*.bb \
            ${LAYERDIR}/recipes-*/*/*.bbappend"

BBFILE_COLLECTIONS += "meta-vicos-mods"
LAYERSERIES_COMPAT_meta-vicos-mods = "whinlatter"
BBFILE_PATTERN_meta-vicos-mods = "^${LAYERDIR}/"
BBFILE_PRIORITY_meta-vicos-mods = "7"
```

## poky/victor/meta-vicos/conf/layer.conf
```bitbake
# We have a conf and classes directory, add to BBPATH
BBPATH .= ":${LAYERDIR}"

# We have recipes-* directories, add to BBFILES
BBFILES += "${LAYERDIR}/recipes-*/*/*.bb \
            ${LAYERDIR}/recipes-*/*/*.bbappend"

BBFILE_COLLECTIONS += "meta-vicos"
LAYERSERIES_COMPAT_meta-vicos = "whinlatter"
BBFILE_PATTERN_meta-vicos = "^${LAYERDIR}/"
BBFILE_PRIORITY_meta-vicos = "6"
```
